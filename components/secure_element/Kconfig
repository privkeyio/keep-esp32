## components/secure_element/Kconfig
```kconfig
menu "Secure Element Configuration"

    config SE_MOCK_MODE
        bool "Use mock secure element (DEV ONLY)"
        default n
        help
            Software simulation of ATECC608B for development.
            WARNING: Provides NO security. Never enable in production.

    config PRODUCTION_BUILD
        bool "Production build"
        default n
        help
            Enable production build mode. This enforces security
            requirements and disables development-only features.
            Mock secure element cannot be used with this enabled.

endmenu
```

## main/Kconfig.projbuild
```kconfig
menu "FROST Participant Configuration"

    config USE_UART_CONSOLE
        bool "Use UART for serial console (for QEMU)"
        default n
        help
            Use UART0 instead of USB Serial JTAG for serial console.
            Enable this for QEMU testing.

    config WIFI_SSID
        string "WiFi SSID"
        default "myssid"
        help
            SSID of the WiFi network to connect to.

    config WIFI_PASSWORD
        string "WiFi Password"
        default "mypassword"
        help
            Password for the WiFi network.

    config NOSTR_RELAY_URL
        string "Nostr Relay URL"
        default "wss://relay.damus.io"
        help
            WebSocket URL of the Nostr relay to connect to.

endmenu

menu "Keep UX Configuration"

    config KEEP_DISPLAY_ENABLED
        bool "Enable display/touch interface"
        default n
        help
            Enable LVGL display and touch input.
            When disabled, device operates in headless serial mode.

    config KEEP_QR_SCANNER_ENABLED
        bool "Enable QR camera scanner"
        default n
        depends on KEEP_DISPLAY_ENABLED
        help
            Enable camera for QR code scanning.
            Requires display mode for camera preview.

    config KEEP_UI_TEST
        bool "UI test build (never for release)"
        default n
        depends on KEEP_DISPLAY_ENABLED
        help
            Lets the host tap the touchscreen and read what it shows over the
            serial protocol, so UI flows can be tested end to end without a
            person. Anyone with USB access could then approve prompts, so this
            must never be enabled in firmware that holds real keys. The screen
            shows a red TEST marker while it is on.

    choice KEEP_DEFAULT_UX_MODE
        prompt "Default UX mode"
        default KEEP_UX_AUTO

        config KEEP_UX_AUTO
            bool "Auto-detect"
            help
                Automatically select display if available, otherwise serial.

        config KEEP_UX_SERIAL
            bool "Force serial (headless)"
            help
                Always use serial protocol, even if display available.

        config KEEP_UX_DISPLAY
            bool "Force display"
            depends on KEEP_DISPLAY_ENABLED
            help
                Always use display mode. Fails if display not available.
    endchoice

endmenu
```
